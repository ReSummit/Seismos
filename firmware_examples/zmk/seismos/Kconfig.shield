## firmware_examples/zmk/seismos/Kconfig.shield
```kconfig
# Copyright (c) 2020 Ryan Cross
# SPDX-License-Identifier: MIT

config SHIELD_SEISMOS_LEFT
    def_bool $(shields_list_contains,seismos_left)

config SHIELD_SEISMOS_RIGHT
    def_bool $(shields_list_contains,seismos_right)
```
